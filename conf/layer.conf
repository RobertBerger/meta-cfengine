## conf/layer.conf
```bitbake
# ### cfengine layer ###
BBPATH =. "${LAYERDIR}:"
BBFILES += "${LAYERDIR}/recipes/*/*.bb \
            ${LAYERDIR}/appends/*.bbappend"
BBFILE_COLLECTIONS += "cfenginelayer"
BBFILE_PATTERN_cfenginelayer = "^${LAYERDIR}/"
BBFILE_PATTERN_IGNORE_EMPTY_cfenginelayer = "1"
BBFILE_PRIORITY_cfenginelayer = "9"
```
